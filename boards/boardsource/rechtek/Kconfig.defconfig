## boards/boardsource/rechtek/Kconfig.defconfig
```kconfig
#
# Copyright (c) 2024 Boardsource
# SPDX-License-Identifier: MIT
#

if BOARD_RECHTEK

config BOARD
    default "rechtek"

config ZMK_KEYBOARD_NAME
    default "Rechtek"

config BT_CTLR
    default BT

if USB

config USB_NRFX
    default y

config USB_DEVICE_STACK
    default y

endif # USB

endif # BOARD_RECHTEK
```

## boards/boardsource/rechtek/Kconfig.rechtek
```kconfig
#
# Copyright (c) 2024 Boardsource
# SPDX-License-Identifier: MIT
#

config BOARD_RECHTEK
    select SOC_NRF52840_QIAA
    select ZMK_BOARD_COMPAT
```

## boards/boardsource/rechtek/board.yml
```yaml
boards:
  - name: rechtek
    vendor: boardsource
    socs:
      - name: nrf52840
    revision:
      format: major.minor.patch
      default: 1.0.0
      exact: false
      revisions:
        - name: 1.0.0
```

## boards/shields/toucan36/Kconfig.defconfig
```kconfig
if SHIELD_TOUCAN36_LEFT

config ZMK_KEYBOARD_NAME
    default "Toucan36"

config ZMK_SPLIT_ROLE_CENTRAL
    default y

config ZMK_SPLIT_BLE_CENTRAL_BATTERY_LEVEL_FETCHING
    default y

config ZMK_SPLIT_BLE_CENTRAL_BATTERY_LEVEL_PROXY
    default y

endif



if SHIELD_TOUCAN36_LEFT || SHIELD_TOUCAN36_RIGHT

config SPI
    default y

config ZMK_SPLIT
    default y

config ZMK_POINTING
    default y

config INPUT_THREAD_PRIORITY_OVERRIDE
    default y

config INPUT_THREAD_PRIORITY
    default 8

config INPUT_THREAD_STACK_SIZE
    default 2048

config RGBLED_WIDGET_BATTERY_LEVEL_HIGH
    default 40

endif
```

## config/west.yml
```yaml
manifest:
  defaults:
    revision: main
  remotes:
    - name: zmkfirmware
      url-base: https://github.com/zmkfirmware
    - name: caksoylar
      url-base: https://github.com/caksoylar
    - name: urob
      url-base: https://github.com/urob
    - name: beekeeb
      url-base: https://github.com/beekeeb
    - name: douglasalbert
      url-base: https://github.com/douglasalbert
  projects:
    - name: zmk
      remote: zmkfirmware
      import: app/west.yml
    - name: zmk-rgbled-widget
      remote: caksoylar
    - name: zmk-helpers
      remote: urob
    - name: zmk-auto-layer
      remote: urob
      revision: dfa7c695ffde41ef8064245453595d50e198ae1d
    - name: zmk-adaptive-key
      remote: urob
      revision: 18cc2795a64ccb394d1a7b7d591a5bfe3f25924b
    - name: zmk_driver_azoteq
      remote: beekeeb
      revision: c329f309b7481e5723603550b15f48e24d0c8a6a
    - name: zmk-input-zoom
      remote: douglasalbert
      revision: 15fbc03e90d55b30b463afab46cdbcb5bf4a8e09 # fork of beekeeb@91bbe0c: guard driver body to fix unused-variable warning
  self:
    path: config
```
