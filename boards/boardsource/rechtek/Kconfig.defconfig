## boards/boardsource/rechtek/Kconfig.defconfig
```kconfig
#
# Copyright (c) 2024 Boardsource
# SPDX-License-Identifier: MIT
#

if BOARD_RECHTEK

config BOARD
    default "rechtek"

config ZMK_KEYBOARD_NAME
    default "Rechtek"

config BT_CTLR
    default BT

config ZMK_BLE
    default y

config ZMK_USB
    default y

if USB

config USB_NRFX
    default y

config USB_DEVICE_STACK
    default y

endif # USB

endif # BOARD_RECHTEK
```
